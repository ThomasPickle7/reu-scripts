/dts-v1/;
/plugin/;

/*
 * This fragment targets the root of the device tree ('/') and adds a
 * 'reserved-memory' node. This node declares a specific region of DDR
 * that the main kernel should not use, making it safe for our DMA driver.
 */
/ {
    fragment@0 {
        target-path = "/";
        __overlay__ {
            reserved-memory {
                #address-cells = <2>;
                #size-cells = <2>;
                ranges;

                /*
                 * Define our 32MB DMA buffer region.
                 * The label 'dma_buffers' is for human readability.
                 * The node name 'dma@c8000000' uses the standard unit-address format.
                 */
                dma_buffers: dma@c8000000 {
                    compatible = "shared-dma-pool";
                    /* This memory is cache-coherent. The kernel will manage it properly,
                       making userspace msync() calls unnecessary. */
                    dma-coherent;
                    /* reg = <addr_hi addr_lo size_hi size_lo> */
                    reg = <0x0 0xc8000000 0x0 0x02000000>; /* 32MB starting at 0xC8000000 */
                    no-map;
                };
            };
        };
    };
};